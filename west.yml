## west.yml
```yaml
manifest:

  remotes:
    - name: zephyrproject-rtos
      url-base: https://github.com/zephyrproject-rtos

  projects:
    - name: zephyr
      remote: zephyrproject-rtos
      revision: v3.3.0
      clone-depth: 1
      import:
        name-allowlist:
          - cmsis
          - hal_stm32

  self:
    west-commands: scripts/west-commands.yml
```
